/**
 * Circul-AI-r Platform — ESP32 CAN Bus Gateway Firmware
 * =====================================================
 * Target hardware : ESP32 DevKit v1 + MCP2515 CAN controller (SPI)
 *                   OR ESP32 with built-in TWAI (CAN) peripheral
 * Battery types   : EV packs, OBD-II accessible BMS (Nissan Leaf, BYD, CATL, etc.)
 * Protocol        : MQTT over TLS (port 8883)
 * Publish rate    : Every 30 seconds (configurable via PUBLISH_INTERVAL_MS)
 *
 * Wiring (MCP2515 via SPI):
 *   MCP2515 CS   → GPIO 5
 *   MCP2515 INT  → GPIO 4
 *   SPI MOSI     → GPIO 23
 *   SPI MISO     → GPIO 19
 *   SPI SCK      → GPIO 18
 *   CAN_H / CAN_L → OBD-II pin 6 / pin 14  (or battery pack CAN connector)
 *
 * Dependencies (install via Arduino Library Manager):
 *   - PubSubClient  (Nick O'Leary)
 *   - MCP_CAN       (Cory Fowler)  — only if using MCP2515
 *   - ArduinoJson   (Benoit Blanchon)
 *   - WiFiClientSecure (built-in ESP32 core)
 *
 * For TWAI (built-in CAN on ESP32):
 *   Replace MCP_CAN calls with ESP32 TWAI driver (see #ifdef USE_TWAI below)
 */

#include <WiFi.h>
#include <WiFiClientSecure.h>
#include <PubSubClient.h>
#include <ArduinoJson.h>
#include <SPI.h>
#include <mcp_can.h>   // Remove if using TWAI

// ─── CONFIGURATION ────────────────────────────────────────────────────────────
// Copy these values from the Device Provisioning page on the platform.

#define WIFI_SSID         "YOUR_WIFI_SSID"
#define WIFI_PASSWORD     "YOUR_WIFI_PASSWORD"

// MQTT credentials — generated by the platform on device registration
#define MQTT_BROKER       "sd1218f1.ala.asia-southeast1.emqxsl.com"
#define MQTT_PORT         8883
#define MQTT_USERNAME     "YOUR_DEVICE_MQTT_USERNAME"   // from Device Provisioning page
#define MQTT_PASSWORD     "YOUR_DEVICE_MQTT_PASSWORD"   // from Device Provisioning page
#define MQTT_TOPIC        "YOUR_MQTT_TOPIC"             // e.g. CAI_/INXYZ12FABCD3456789AB/telemetry
#define DEVICE_BPAN       "YOUR_BATTERY_BPAN"          // 21-char BPAN from BPAN Registry

// Battery pack parameters — adjust to match your pack
#define CELL_COUNT_SERIES    96     // e.g. Nissan Leaf 2nd gen = 96s2p
#define NOMINAL_CAPACITY_AH  40.0  // Ah
#define CHEMISTRY            "NMC"  // NMC | LFP | NCA | LCO | LMO | LEAD_ACID

// Publish interval
#define PUBLISH_INTERVAL_MS  30000  // 30 seconds

// CAN chip select pin (MCP2515)
#define CAN_CS_PIN  5

// ─── CAN MESSAGE IDs (adjust for your BMS brand) ──────────────────────────────
// These are example PIDs for a generic BMS. Real values vary by manufacturer.
// Use a CAN bus analyser (e.g. SavvyCAN) to discover your BMS's actual PIDs.
#define CAN_ID_PACK_VOLTAGE   0x1B0   // Pack voltage (2 bytes, factor 0.1V)
#define CAN_ID_PACK_CURRENT   0x1B2   // Pack current (2 bytes, signed, factor 0.1A)
#define CAN_ID_SOC            0x1B4   // State of Charge (1 byte, 0–100%)
#define CAN_ID_TEMP_1         0x1B6   // Temperature sensor 1 (1 byte, offset -40°C)
#define CAN_ID_TEMP_2         0x1B8   // Temperature sensor 2
#define CAN_ID_CYCLE_COUNT    0x1BA   // Cycle count (2 bytes)
#define CAN_ID_CELL_MIN_V     0x1BC   // Min cell voltage (2 bytes, factor 0.001V)
#define CAN_ID_CELL_MAX_V     0x1BE   // Max cell voltage (2 bytes, factor 0.001V)

// ─── GLOBALS ──────────────────────────────────────────────────────────────────
MCP_CAN CAN(CAN_CS_PIN);
WiFiClientSecure wifiClient;
PubSubClient mqttClient(wifiClient);

// Telemetry state — updated from CAN frames
struct TelemetryState {
  float vPack    = 0.0;
  float iPack    = 0.0;
  float soc      = 0.0;
  float tMax     = 0.0;
  float tMin     = 0.0;
  float tAvg     = 0.0;
  float vCellMin = 0.0;
  float vCellMax = 0.0;
  int   cycles   = 0;
  float soh      = 100.0;  // Estimated from cycle count + capacity fade
} state;

unsigned long lastPublishMs = 0;
unsigned long totalReadings = 0;

// ─── WIFI ─────────────────────────────────────────────────────────────────────
void connectWifi() {
  Serial.printf("[WiFi] Connecting to %s", WIFI_SSID);
  WiFi.begin(WIFI_SSID, WIFI_PASSWORD);
  while (WiFi.status() != WL_CONNECTED) {
    delay(500);
    Serial.print(".");
  }
  Serial.printf("\n[WiFi] Connected. IP: %s\n", WiFi.localIP().toString().c_str());
}

// ─── MQTT ─────────────────────────────────────────────────────────────────────
void connectMqtt() {
  // Accept any TLS certificate from the broker (suitable for development).
  // For production, replace with: wifiClient.setCACert(root_ca_pem);
  wifiClient.setInsecure();

  mqttClient.setServer(MQTT_BROKER, MQTT_PORT);
  mqttClient.setBufferSize(512);

  while (!mqttClient.connected()) {
    Serial.print("[MQTT] Connecting...");
    String clientId = "circul-air-" + String(DEVICE_BPAN);
    if (mqttClient.connect(clientId.c_str(), MQTT_USERNAME, MQTT_PASSWORD)) {
      Serial.println(" connected.");
    } else {
      Serial.printf(" failed (rc=%d). Retry in 5s.\n", mqttClient.state());
      delay(5000);
    }
  }
}

// ─── CAN BUS READER ───────────────────────────────────────────────────────────
void readCanFrames() {
  unsigned long canId;
  unsigned char len;
  unsigned char buf[8];

  // Drain all pending CAN frames in one pass
  while (CAN_MSGAVAIL == CAN.checkReceive()) {
    CAN.readMsgBuf(&canId, &len, buf);

    switch (canId) {
      case CAN_ID_PACK_VOLTAGE:
        state.vPack = ((buf[0] << 8) | buf[1]) * 0.1f;
        break;

      case CAN_ID_PACK_CURRENT:
        // Signed 16-bit, positive = charging, negative = discharging
        state.iPack = (int16_t)((buf[0] << 8) | buf[1]) * 0.1f;
        break;

      case CAN_ID_SOC:
        state.soc = buf[0];
        break;

      case CAN_ID_TEMP_1:
        state.tMax = buf[0] - 40;  // offset encoding
        break;

      case CAN_ID_TEMP_2:
        state.tMin = buf[0] - 40;
        state.tAvg = (state.tMax + state.tMin) / 2.0f;
        break;

      case CAN_ID_CYCLE_COUNT:
        state.cycles = (buf[0] << 8) | buf[1];
        // Simple linear SOH estimate: 100% at 0 cycles, ~80% at 1000 cycles (NMC)
        state.soh = max(0.0f, 100.0f - (state.cycles * 0.02f));
        break;

      case CAN_ID_CELL_MIN_V:
        state.vCellMin = ((buf[0] << 8) | buf[1]) * 0.001f;
        break;

      case CAN_ID_CELL_MAX_V:
        state.vCellMax = ((buf[0] << 8) | buf[1]) * 0.001f;
        break;
    }
  }
}

// ─── PAYLOAD BUILDER ──────────────────────────────────────────────────────────
String buildPayload() {
  StaticJsonDocument<512> doc;

  doc["bpan"]       = DEVICE_BPAN;
  doc["ts"]         = millis();          // Replace with NTP epoch if available
  doc["vPack"]      = round(state.vPack * 10) / 10.0;
  doc["iPack"]      = round(state.iPack * 10) / 10.0;
  doc["soc"]        = state.soc;
  doc["tMax"]       = state.tMax;
  doc["tMin"]       = state.tMin;
  doc["tAvg"]       = state.tAvg;
  doc["vCellMin"]   = round(state.vCellMin * 1000) / 1000.0;
  doc["vCellMax"]   = round(state.vCellMax * 1000) / 1000.0;
  doc["cycleCount"] = state.cycles;
  doc["sohEstimate"]= round(state.soh * 10) / 10.0;
  doc["chemistry"]  = CHEMISTRY;

  // Thermal anomaly flag — platform also detects this server-side
  doc["thermalAnomaly"] = (state.tMax > 51.0);

  String payload;
  serializeJson(doc, payload);
  return payload;
}

// ─── SETUP ────────────────────────────────────────────────────────────────────
void setup() {
  Serial.begin(115200);
  Serial.println("\n[Circul-AI-r] CAN Gateway starting...");

  // Initialise CAN bus at 500 kbps (standard for automotive BMS)
  // Change to CAN_250KBPS for some industrial packs
  while (CAN_OK != CAN.begin(MCP_ANY, CAN_500KBPS, MCP_8MHZ)) {
    Serial.println("[CAN] Init failed. Retrying...");
    delay(1000);
  }
  CAN.setMode(MCP_NORMAL);
  Serial.println("[CAN] Initialised at 500 kbps.");

  connectWifi();
  connectMqtt();

  Serial.printf("[Circul-AI-r] Gateway ready. Publishing to %s every %d ms\n",
                MQTT_TOPIC, PUBLISH_INTERVAL_MS);
}

// ─── LOOP ─────────────────────────────────────────────────────────────────────
void loop() {
  // Maintain MQTT connection
  if (!mqttClient.connected()) {
    connectMqtt();
  }
  mqttClient.loop();

  // Read all pending CAN frames
  readCanFrames();

  // Publish on interval
  unsigned long now = millis();
  if (now - lastPublishMs >= PUBLISH_INTERVAL_MS) {
    lastPublishMs = now;

    String payload = buildPayload();
    bool ok = mqttClient.publish(MQTT_TOPIC, payload.c_str(), false);

    totalReadings++;
    Serial.printf("[MQTT] Published reading #%lu (%s): %s\n",
                  totalReadings, ok ? "OK" : "FAIL", payload.c_str());

    // Warn on thermal anomaly
    if (state.tMax > 51.0) {
      Serial.printf("[ALERT] Thermal anomaly! T_max=%.1f°C\n", state.tMax);
    }
  }
}
